## drivers/misc/transsion/binder/Kconfig
```kconfig
config TRAN_ANDROID_BINDER_BLOCK_MONITOR
        bool "android binder block monitor"
        default y
        ---help---
            monitor critical process binder ipc, and get server process info.
endif # if TRAN_ANDROID_BINDER_BLOCK_MONITOR
```

## drivers/pinctrl/sunxi/Kconfig
```kconfig
# SPDX-License-Identifier: GPL-2.0-only
if ARCH_SUNXI

config PINCTRL_SUNXI
	tristate
	select PINMUX
	select GENERIC_PINCONF
	select GPIOLIB

config PINCTRL_SUNIV_F1C100S
	def_bool MACH_SUNIV
	select PINCTRL_SUNXI

config PINCTRL_SUN4I_A10
	tristate "Support for the Allwinner A10, A20 and R40 PIO"
	default MACH_SUN4I || MACH_SUN7I || MACH_SUN8I
	select PINCTRL_SUNXI

config PINCTRL_SUN5I
	tristate "Support for the Allwinner A10s, A13, R8 and NextThing GR8 PIO"
	default MACH_SUN5I
	select PINCTRL_SUNXI

config PINCTRL_SUN6I_A31
	tristate "Support for the Allwinner A31 PIO"
	default MACH_SUN6I
	select PINCTRL_SUNXI

config PINCTRL_SUN6I_A31_R
	tristate "Support for the Allwinner A31 R-PIO"
	default MACH_SUN6I
	depends on RESET_CONTROLLER
	select PINCTRL_SUNXI

config PINCTRL_SUN8I_A23
	tristate "Support for the Allwinner A23 PIO"
	default MACH_SUN8I
	select PINCTRL_SUNXI

config PINCTRL_SUN8I_A33
	tristate "Support for the Allwinner A33 PIO"
	default MACH_SUN8I
	select PINCTRL_SUNXI

config PINCTRL_SUN8I_A83T
	tristate "Support for the Allwinner A83T PIO"
	default MACH_SUN8I
	select PINCTRL_SUNXI

config PINCTRL_SUN8I_A83T_R
	tristate "Support for the Allwinner A83T R-PIO"
	default MACH_SUN8I
	select PINCTRL_SUNXI

config PINCTRL_SUN8I_A23_R
	tristate "Support for the Allwinner A23 and A33 R-PIO"
	default MACH_SUN8I
	depends on RESET_CONTROLLER
	select PINCTRL_SUNXI

config PINCTRL_SUN8I_H3
	tristate "Support for the Allwinner H3 PIO"
	default MACH_SUN8I
	select PINCTRL_SUNXI

config PINCTRL_SUN8I_H3_R
	tristate "Support for the Allwinner H3 and H5 R-PIO"
	select PINCTRL_SUNXI

config PINCTRL_SUN8I_V3S
	tristate "Support for the Allwinner V3s PIO"
	default MACH_SUN8I
	select PINCTRL_SUNXI

config PINCTRL_SUN9I_A80
	tristate "Support for the Allwinner A80 PIO"
	default MACH_SUN9I
	select PINCTRL_SUNXI

config PINCTRL_SUN9I_A80_R
	tristate "Support for the Allwinner A80 R-PIO"
	default MACH_SUN9I
	depends on RESET_CONTROLLER
	select PINCTRL_SUNXI

config PINCTRL_SUN50I_A64
	tristate "Support for the Allwinner A64 PIO"
	select PINCTRL_SUNXI

config PINCTRL_SUN50I_A64_R
	tristate "Support for the Allwinner A64 R-PIO"
	select PINCTRL_SUNXI

config PINCTRL_SUN50I_H5
	tristate "Support for the Allwinner H5 PIO"
	select PINCTRL_SUNXI

config PINCTRL_SUN50I_H6
	tristate "Support for the Allwinner H6 PIO"
	select PINCTRL_SUNXI

config PINCTRL_SUN50I_H6_R
	tristate "Support for the Allwinner H6 R-PIO"
	select PINCTRL_SUNXI

endif
```

## drivers/tty/serial/pkvm-8250/Kconfig
```kconfig
# SPDX-License-Identifier: GPL-2.0

config SERIAL_PKVM_8250
	tristate "Protected KVM 8250 UART"
	depends on ARM64
	depends on KVM

config SERIAL_PKVM_8250_BASE_PHYS
	hex
	depends on SERIAL_PKVM_8250
	default 0x11002000
```

## drivers/virt/halla/Kconfig
```kconfig
# SPDX-License-Identifier: GPL-2.0-only
#
# Exynos HVM solutions
#

config EXYNOS_HVM
	tristate "Exynos Halla VM"
	depends on ARM64 && EVENTFD
	help
	  Exynos Halla VM Management module.
```

## fs/crypto/Kconfig
```kconfig
config FS_ENCRYPTION
	tristate "FS Encryption (Per-file encryption)"
	select CRYPTO
	select CRYPTO_AES
	select CRYPTO_CBC
	select CRYPTO_ECB
	select CRYPTO_XTS
	select CRYPTO_CTS
	select CRYPTO_CTR
	select CRYPTO_SHA256
	select KEYS
	help
	  Enable encryption of files and directories.  This
	  feature is similar to ecryptfs, but it is more memory
	  efficient since it avoids caching the encrypted and
	  decrypted pages in the page cache.

config FS_ENCRYPTION_HW_CRYPT
	tristate "Enable fscrypt to use inline crypto"
	default n
	depends on FS_ENCRYPTION && BLK_KEYSLOT_MANAGER
	help
	  Enables fscrypt to use inline crypto engine if available,
	  through the struct keyslot_manager in struct request_queue.
```

## mm/damon/Kconfig
```kconfig
# SPDX-License-Identifier: GPL-2.0-only

menu "Data Access Monitoring"

config DAMON
	bool "DAMON: Data Access Monitoring Framework"
	default y
	help
	  This builds a framework that allows kernel subsystems to monitor
	  access frequency of each memory region. The information can be useful
	  for performance-centric DRAM level memory management.

	  See https://damonitor.github.io/doc/html/latest-damon/index.html for
	  more information.

config DAMON_PADDR
	bool "Data access monitoring primitives for the physical address space"
	depends on DAMON && MMU
	select PAGE_IDLE_FLAG
	default y
	help
	  This builds the default data access monitoring primitives for DAMON
	  that works for the physical address space.

config DAMON_RECLAIM
	bool "Build DAMON-based reclaim (DAMON_RECLAIM)"
	depends on DAMON_PADDR
	default y
	help
	  This builds the DAMON-based reclamation subsystem.  It finds pages
	  that not accessed for a long time (cold) using DAMON and reclaim
	  those.

	  This is suggested to be used as a proactive and lightweight
	  reclamation under light memory pressure, while the traditional page
	  scanning-based reclamation is used for heavy pressure.

endmenu
```

## net/dualpi2/Kconfig
```kconfig
config NET_SCH_DUALPI2
        tristate "Dual Queue Proportional Integral Controller Improved with a Square (DUALPI2) scheduler"
        help
          Say Y here if you want to use the DualPI2 AQM.
          This is a combination of the DUALQ Coupled-AQM with a PI2 base-AQM.
          The PI2 AQM is in turn both an extension and a simplification of the
          PIE AQM. PI2 makes quite some PIE heuristics unnecessary, while being
          able to control scalable congestion controls like DCTCP and
          TCP-Prague. With PI2, both Reno/Cubic can be used in parallel with
          DCTCP, maintaining window fairness. DUALQ provides latency separation
          between low latency DCTCP flows and Reno/Cubic flows that need a
          bigger queue.
          For more information, please see
          https://www.ietf.org/id/draft-ietf-tsvwg-aqm-dualq-coupled
 
          To compile this code as a module, choose M here: the module
          will be called sch_dualpi2.
 
          If unsure, say N.
```
