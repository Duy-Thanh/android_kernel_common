## drivers/gpu/trace/Kconfig
```kconfig
# SPDX-License-Identifier: GPL-2.0-only

config TRACE_GPU_MEM
	bool

config TRACE_GPU_WORK_PERIOD
        bool "Enable GPU work period tracepoint"
        default n
        help
          Choose this option to enable tracepoint for tracking
          GPU usage based on the UID. Intended for performance
          profiling and required for Android.

          Tracepoint availability varies by GPU driver.

          If in doubt, say "N".
```

## drivers/media/platform/google/lwis/Kconfig
```kconfig
# SPDX-License-Identifier: GPL-2.0-only

config VIDEO_GOOGLE_LWIS
	tristate "Google LWIS Image Sensor Driver"
	depends on V4L_PLATFORM_DRIVERS
	depends on OF && I2C
	help
	  Say Y here to enable support for Google Lightweight Image Subsystem (LWIS)
	  sensors including Sony IMX08B (ICHI).
```

## drivers/misc/nekkodrv/Kconfig
```kconfig
# SPDX-License-Identifier: GPL-2.0-only
#
# Copyright (C) 2026
# Author: Nguyen Duy Thanh <nekkochan0x0007@proton.me>
#

config NEKKODRV_MODULE
	tristate "Custom module for new hypervisor"
	default m
	help
	  Custom module for new hypervisor
```
